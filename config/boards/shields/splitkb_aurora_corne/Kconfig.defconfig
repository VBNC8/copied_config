## config/boards/shields/splitkb_aurora_corne/Kconfig.defconfig
```kconfig
if SHIELD_SPLITKB_AURORA_CORNE_LEFT || SHIELD_SPLITKB_AURORA_CORNE_RIGHT

config ZMK_INPUT
    bool "ZMK Input"
    default y

config ZMK_INPUT_MOUSE_PS2
    bool "PS2 Mouse Support"
    default y

config ZMK_INPUT_MOUSE_PS2_SENSITIVITY
    int "Mouse Sensitivity"
    default 120

config ZMK_INPUT_MOUSE_PS2_REPORT_INTERVAL
    int "Mouse Report Interval"
    default 10

endif
```

## config/west.yml
```yaml
manifest:
  projects:
    - name: zmk
      url: https://github.com/zmk-pointing/zmk.git
      revision: main
      import: app/west.yml
  self:
    path: config
```
